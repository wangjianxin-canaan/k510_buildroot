## configs/k510_crb_lp3_v1_2_defconfig
```kconfig
BR2_riscv=y
BR2_DL_DIR="$(TOPDIR)/../dl"
BR2_JLEVEL=5
BR2_GLOBAL_PATCH_DIR="$(TOPDIR)/../package/patches"
BR2_TOOLCHAIN_EXTERNAL=y
BR2_TOOLCHAIN_EXTERNAL_PATH="$(TOPDIR)/../toolchain/nds64le-linux-glibc-v5d"
BR2_TOOLCHAIN_EXTERNAL_GCC_7=y
BR2_TOOLCHAIN_EXTERNAL_HEADERS_4_17=y
BR2_TOOLCHAIN_EXTERNAL_CUSTOM_GLIBC=y
BR2_TOOLCHAIN_EXTERNAL_CXX=y
BR2_TOOLCHAIN_EXTERNAL_OPENMP=y
BR2_ROOTFS_SKELETON_CUSTOM=y
BR2_ROOTFS_SKELETON_CUSTOM_PATH="$(TOPDIR)/../board/canaan/k510/k510_rootfs_skeleton"
BR2_ROOTFS_DEVICE_CREATION_DYNAMIC_MDEV=y
BR2_ROOTFS_DEVICE_TABLE=""
BR2_ROOTFS_POST_BUILD_SCRIPT="$(TOPDIR)/../board/canaan/k510/post_build.sh"
BR2_ROOTFS_POST_IMAGE_SCRIPT="$(TOPDIR)/../board/canaan/k510/post-image-crb_v1_2.sh"
BR2_LINUX_KERNEL=y
BR2_LINUX_KERNEL_CUSTOM_VERSION=y
BR2_LINUX_KERNEL_CUSTOM_VERSION_VALUE="4.17"
BR2_LINUX_KERNEL_DEFCONFIG="k510"
BR2_LINUX_KERNEL_VMLINUX=y
BR2_PACKAGE_BUSYBOX_CONFIG="$(TOPDIR)/../board/canaan/k510/k510_busybox.config"
BR2_PACKAGE_STRESS_NG=y
BR2_PACKAGE_RNG_TOOLS=y
BR2_PACKAGE_LZO=y
BR2_PACKAGE_LIBFFI=y
BR2_PACKAGE_LIBPTHREAD_STUBS=y
BR2_PACKAGE_LIBUV=y
BR2_PACKAGE_NCURSES=y
BR2_PACKAGE_IPERF=y
BR2_PACKAGE_NTP=y
# BR2_PACKAGE_NTP_NTPD is not set
BR2_PACKAGE_NTP_NTPDATE=y
BR2_PACKAGE_TCPDUMP=y
BR2_PACKAGE_TCPDUMP_SMB=y
BR2_PACKAGE_WPA_SUPPLICANT=y
BR2_PACKAGE_WPA_SUPPLICANT_AP_SUPPORT=y
BR2_PACKAGE_WPA_SUPPLICANT_WIFI_DISPLAY=y
BR2_PACKAGE_WPA_SUPPLICANT_MESH_NETWORKING=y
BR2_PACKAGE_WPA_SUPPLICANT_AUTOSCAN=y
BR2_PACKAGE_WPA_SUPPLICANT_EAP=y
BR2_PACKAGE_WPA_SUPPLICANT_HOTSPOT=y
BR2_PACKAGE_WPA_SUPPLICANT_DEBUG_SYSLOG=y
BR2_PACKAGE_WPA_SUPPLICANT_WPS=y
BR2_PACKAGE_WPA_SUPPLICANT_WPA3=y
BR2_PACKAGE_WPA_SUPPLICANT_CLI=y
BR2_PACKAGE_WPA_SUPPLICANT_PASSPHRASE=y
BR2_PACKAGE_WPA_SUPPLICANT_DBUS=y
BR2_PACKAGE_UTIL_LINUX=y
BR2_PACKAGE_UTIL_LINUX_LIBBLKID=y
BR2_PACKAGE_UTIL_LINUX_LIBUUID=y
BR2_TARGET_ROOTFS_EXT2=y
BR2_TARGET_ROOTFS_EXT2_SIZE="512M"
BR2_TARGET_ROOTFS_INITRAMFS=y
BR2_TARGET_UBOOT=y
BR2_TARGET_UBOOT_BOARD_DEFCONFIG="k510_crb_lp3_v1_2"
BR2_PACKAGE_HOST_GENIMAGE=y
BR2_PACKAGE_HOST_PYTHON_CYTHON=y
BR2_PACKAGE_HOST_PYTHON_LXML=y
BR2_PACKAGE_HOST_PYTHON_SIX=y
BR2_PACKAGE_HOST_PYTHON_XLRD=y
BR2_PACKAGE_HOST_PYTHON3=y
BR2_TARGET_BOARD_TYPE="crb"
BR2_PACKAGE_DSP_APP_NEW=y
BR2_TARGET_EVB_FIRMWARE_LOAD_ADD=0x80000000
BR2_PACKAGE_K510_EVB_TEST=y
BR2_TARGET_K510_EVB_TEST_FFT_FIRMWARE=y
BR2_TARGET_K510_EVB_TEST_MAILBOX_FIRMWARE=y
BR2_TARGET_K510_EVB_TEST_SIMD_UMUL8_FIRMWARE=y
BR2_PACKAGE_CLIENT=y
BR2_PACKAGE_SERVER=y
BR2_PACKAGE_UDP_CLIENT=y
BR2_PACKAGE_KO_HELLO_WORLD=y
```

## package/ko_hello_world/Config.in
```kconfig
config BR2_PACKAGE_KO_HELLO_WORLD
bool "ko_hello_world"
depends on BR2_LINUX_KERNEL
help
Test for adding driver in buildroot

comment "ko_hello_world driver needs a Linux kernel to be built"
depends on !BR2_LINUX_KERNEL
```

## package/tcp_client/Config.in
```kconfig
config BR2_PACKAGE_TCP_CLIENT
	bool "tcp_client"
	depends on BR2_riscv
	help
	  k510 tcp client for demo
```

## package/tcp_server/Config.in
```kconfig
config BR2_PACKAGE_TCP_SERVER
	bool "tcp_server"
	depends on BR2_riscv
	help
	  k510 tcp server for demo
```

## package/udp_client/Config.in
```kconfig
config BR2_PACKAGE_UDP_CLIENT
	bool "udp_client"
	depends on BR2_riscv
	help
	  k510 udp client for demo
```

## package/udp_server/Config.in
```kconfig
config BR2_PACKAGE_UDP_SERVER
	bool "udp_server"
	depends on BR2_riscv
	help
	  k510 udp server for demo
```

## tools/defconfig
```kconfig
CONFIG_SMP=y
CONFIG_NR_CPUS=4
CONFIG_ANDES_PMU=y
CONFIG_CMA=y
CONFIG_CMA_DEBUG=y
CONFIG_CMA_DEBUGFS=y
CONFIG_PREEMPT=y
CONFIG_HZ_100=y
CONFIG_CROSS_COMPILE="riscv64-linux-"
CONFIG_DEFAULT_HOSTNAME="k510-test"
# CONFIG_SWAP is not set
CONFIG_SYSVIPC=y
CONFIG_POSIX_MQUEUE=y
CONFIG_HIGH_RES_TIMERS=y
CONFIG_BSD_PROCESS_ACCT=y
CONFIG_BSD_PROCESS_ACCT_V3=y
CONFIG_IKCONFIG=y
CONFIG_IKCONFIG_PROC=y
CONFIG_LOG_BUF_SHIFT=14
CONFIG_CGROUPS=y
CONFIG_CGROUP_SCHED=y
CONFIG_CFS_BANDWIDTH=y
CONFIG_CGROUP_CPUACCT=y
CONFIG_NAMESPACES=y
CONFIG_USER_NS=y
CONFIG_BLK_DEV_INITRD=y
CONFIG_INITRAMFS_SOURCE="${BR_BINARIES_DIR}/rootfs.cpio"
CONFIG_SYSCTL_SYSCALL=y
CONFIG_CHECKPOINT_RESTORE=y
CONFIG_KALLSYMS_ALL=y
CONFIG_EMBEDDED=y
CONFIG_PROFILING=y
CONFIG_MODULES=y
CONFIG_MODULE_UNLOAD=y
# CONFIG_BLK_DEV_BSG is not set
CONFIG_PARTITION_ADVANCED=y
# CONFIG_EFI_PARTITION is not set
# CONFIG_IOSCHED_DEADLINE is not set
CONFIG_NET=y
CONFIG_PACKET=y
CONFIG_UNIX=y
CONFIG_NET_KEY=y
CONFIG_INET=y
CONFIG_IP_PNP=y
CONFIG_IP_PNP_DHCP=y
CONFIG_IP_PNP_BOOTP=y
CONFIG_IP_PNP_RARP=y
# CONFIG_INET_XFRM_MODE_TRANSPORT is not set
# CONFIG_INET_XFRM_MODE_TUNNEL is not set
# CONFIG_INET_XFRM_MODE_BEET is not set
# CONFIG_INET_DIAG is not set
CONFIG_DNS_RESOLVER=y
CONFIG_CFG80211=m
CONFIG_CFG80211_WEXT=y
CONFIG_RFKILL=y
CONFIG_RFKILL_INPUT=y
CONFIG_RFKILL_GPIO=y
CONFIG_DEVTMPFS=y
CONFIG_DEVTMPFS_MOUNT=y
CONFIG_DMA_CMA=y
CONFIG_MTD=y
CONFIG_MTD_BLOCK=y
CONFIG_FTL=y
CONFIG_NFTL=y
CONFIG_NFTL_RW=y
CONFIG_INFTL=y
CONFIG_MTD_NAND=y
CONFIG_MTD_SPI_NOR=y
CONFIG_MTD_UBI=y
CONFIG_BLK_DEV_LOOP=y
CONFIG_K510_GNNE_DRIVER=y
CONFIG_K510_DSP_DRIVER=y
CONFIG_SCSI=y
# CONFIG_SCSI_PROC_FS is not set
CONFIG_BLK_DEV_SD=y
# CONFIG_SCSI_LOWLEVEL is not set
CONFIG_NETDEVICES=y
CONFIG_TUN=y
CONFIG_MACB=y
# CONFIG_MACB_USE_HWSTAMP is not set
CONFIG_FTMAC100=y
CONFIG_SMSC_PHY=y
CONFIG_BRCMFMAC=m
CONFIG_INPUT_EVDEV=y
CONFIG_KEYBOARD_GPIO=y
# CONFIG_INPUT_MOUSE is not set
CONFIG_INPUT_TOUCHSCREEN=y
CONFIG_TOUCHSCREEN_GOODIX=y
CONFIG_DEVKMEM=y
CONFIG_SERIAL_8250=y
# CONFIG_SERIAL_8250_DEPRECATED_OPTIONS is not set
CONFIG_SERIAL_8250_CONSOLE=y
CONFIG_SERIAL_8250_DW=y
CONFIG_SERIAL_OF_PLATFORM=y
CONFIG_HW_RANDOM=y
CONFIG_I2C_CHARDEV=y
CONFIG_I2C_MUX=y
CONFIG_I2C_DESIGNWARE_PLATFORM=y
CONFIG_I2C_GPIO=y
CONFIG_I2C_DEBUG_CORE=y
CONFIG_I2C_DEBUG_ALGO=y
CONFIG_I2C_DEBUG_BUS=y
CONFIG_PINCTRL=y
CONFIG_PINCTRL_SINGLE=y
CONFIG_PINCTRL_K510=y
CONFIG_GPIOLIB=y
CONFIG_DEBUG_GPIO=y
CONFIG_GPIO_SYSFS=y
CONFIG_GPIO_DWAPB=y
CONFIG_GPIO_PCA953X=y
CONFIG_GPIO_PCA953X_IRQ=y
# CONFIG_HWMON is not set
CONFIG_THERMAL=y
CONFIG_CANAAN_THERMAL=y
CONFIG_WATCHDOG=y
CONFIG_WATCHDOG_SYSFS=y
CONFIG_DW_WATCHDOG=y
CONFIG_MFD_SYSCON=y
CONFIG_DRM=y
CONFIG_DRM_KENDRYTE=y
CONFIG_KENDRYTE_CADENCE_MIPI_DSI=y
CONFIG_DRM_PANEL_SIMPLE=y
CONFIG_FB_FTLCDC100=y
CONFIG_BACKLIGHT_LCD_SUPPORT=y
CONFIG_LCD_CLASS_DEVICE=y
CONFIG_BACKLIGHT_CLASS_DEVICE=y
CONFIG_BACKLIGHT_GPIO=y
CONFIG_KENDRYTE_TWOD=y
CONFIG_DUMMY_CONSOLE_COLUMNS=40
CONFIG_DUMMY_CONSOLE_ROWS=30
CONFIG_FRAMEBUFFER_CONSOLE=y
CONFIG_LOGO=y
# CONFIG_USB_SUPPORT is not set
CONFIG_RTC_CLASS=y
CONFIG_RTC_DRV_KENDRYTE=y
CONFIG_DMADEVICES=y
CONFIG_DMADEVICES_DEBUG=y
CONFIG_K510_PERIDMA=y
CONFIG_COMMON_CLK_CAN_K510=y
CONFIG_MAILBOX=y
CONFIG_CANAAN_MBOX=y
CONFIG_CANAAN_MBOX_CLIENT=y
# CONFIG_IOMMU_SUPPORT is not set
CONFIG_CANAAN_PM_DOMAIN=y
CONFIG_MEMORY=y
CONFIG_CANAAN_MEMORY=y
CONFIG_PWM=y
CONFIG_PWM_GPIO=y
CONFIG_PWM_CANAAN=y
CONFIG_RESET_CONTROLLER=y
CONFIG_COMMON_RESET_K510=y
CONFIG_GENERIC_PHY=y
CONFIG_EXT2_FS=y
CONFIG_EXT4_FS=y
CONFIG_EXT4_FS_POSIX_ACL=y
CONFIG_EXT4_FS_SECURITY=y
CONFIG_EXT4_ENCRYPTION=y
CONFIG_EXPORTFS_BLOCK_OPS=y
CONFIG_FANOTIFY=y
CONFIG_MSDOS_FS=y
CONFIG_VFAT_FS=y
CONFIG_TMPFS=y
CONFIG_TMPFS_POSIX_ACL=y
CONFIG_CONFIGFS_FS=y
CONFIG_UBIFS_FS=y
CONFIG_UBIFS_FS_ADVANCED_COMPR=y
CONFIG_NFS_FS=y
CONFIG_NFS_V3_ACL=y
CONFIG_NFS_V4=y
CONFIG_NFS_V4_1=y
CONFIG_NFS_V4_2=y
CONFIG_ROOT_NFS=y
CONFIG_NFS_USE_LEGACY_DNS=y
CONFIG_NLS_CODEPAGE_437=y
CONFIG_NLS_ISO8859_1=y
CONFIG_PRINTK_TIME=y
CONFIG_DYNAMIC_DEBUG=y
CONFIG_DEBUG_INFO=y
CONFIG_DEBUG_INFO_DWARF4=y
CONFIG_GDB_SCRIPTS=y
CONFIG_READABLE_ASM=y
CONFIG_DEBUG_FS=y
CONFIG_HEADERS_CHECK=y
CONFIG_DEBUG_SECTION_MISMATCH=y
CONFIG_PTDUMP_DEBUGFS=y
CONFIG_PANIC_ON_OOPS=y
# CONFIG_DEBUG_PREEMPT is not set
CONFIG_STACKTRACE=y
CONFIG_RCU_CPU_STALL_TIMEOUT=300
# CONFIG_FTRACE is not set
CONFIG_CRYPTO_ECHAINIV=y
CONFIG_CRYPTO_USER_API_HASH=y
CONFIG_CRYPTO_USER_API_SKCIPHER=y
CONFIG_CRYPTO_USER_API_AEAD=y
CONFIG_CRYPTO_DEV_KENDRYTE=y
CONFIG_CRYPTO_DEV_KENDRYTE_HASH=y
CONFIG_CRYPTO_DEV_KENDRYTE_CRYP=y
CONFIG_GENERIC_ALLOCATOR=y
```
